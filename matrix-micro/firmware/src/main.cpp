/**
 * MATRIX ESP32 Firmware — MPDT Neuron Evaluation on Microcontroller
 *
 * Evaluates pre-compiled MPDT neurons generated by ldn2h.py.
 * Communicates via UART (sensor input → neuron → actuator output).
 *
 * Build: pio run
 * Flash: pio run --target upload
 * Monitor: pio run --target monitor
 */

#include "../src/mpdt_neuron.h"
#include "matrix_neurons.h"

#include <Arduino.h>

#define BAUD_RATE 115200
#define MAX_NEURONS 16

static const MPDTNeuron *neurons[MAX_NEURONS];
static int neuron_count = 0;

void setup() {
    Serial.begin(BAUD_RATE);
    while (!Serial) { delay(10); }

    Serial.println("MATRIX ESP32 Firmware v1.0");

    neuron_count = MATRIX_NEURON_COUNT;
    if (neuron_count > MAX_NEURONS) neuron_count = MAX_NEURONS;

    for (int i = 0; i < neuron_count; i++) {
        if (mpdt_validate(matrix_neurons[i])) {
            neurons[i] = matrix_neurons[i];
            Serial.printf("Neuron %d: k=%d valid\n", i, neurons[i]->k);
        }
    }

    if (neuron_count == 0) {
        Serial.println("WARNING: No valid neurons found!");
    }
}

void loop() {
    if (Serial.available() >= 8) {
        uint32_t sensor_input = 0;
        for (int i = 0; i < 4; i++) {
            sensor_input |= ((uint32_t)Serial.read()) << (i * 8);
        }

        uint32_t start = micros();
        uint32_t result = 0;
        for (int i = 0; i < neuron_count; i++) {
            if (neurons[i] && mpdt_evaluate(neurons[i], sensor_input)) {
                result |= (1 << i);
            }
        }
        uint32_t elapsed = micros() - start;

        Serial.write((uint8_t)(result & 0xFF));
        Serial.write((uint8_t)((result >> 8) & 0xFF));
        Serial.write((uint8_t)((result >> 16) & 0xFF));
        Serial.write((uint8_t)((result >> 24) & 0xFF));
        Serial.write((uint8_t)(elapsed & 0xFF));
        Serial.write((uint8_t)((elapsed >> 8) & 0xFF));
        Serial.write((uint8_t)((elapsed >> 16) & 0xFF));
        Serial.write((uint8_t)((elapsed >> 24) & 0xFF));
    }
}
